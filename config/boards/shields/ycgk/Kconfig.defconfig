## config/boards/shields/ycgk/Kconfig.defconfig
```kconfig
# Copyright (c) 2020 The ZMK Contributors
# SPDX-License-Identifier: MIT

if SHIELD_YCGK_LEFT

config ZMK_KEYBOARD_NAME
	default "ycgk"

config ZMK_SPLIT_BLE_ROLE_CENTRAL
	default y

endif

if SHIELD_YCGK_LEFT || SHIELD_YCGK_RIGHT

config ZMK_SPLIT
	default y

endif
```

## config/boards/shields/ycgk/Kconfig.shield
```kconfig
# Copyright (c) 2020 The ZMK Contributors
# SPDX-License-Identifier: MIT

config SHIELD_YCGK_LEFT
	def_bool $(shields_list_contains,ycgk_left)

config SHIELD_YCGK_RIGHT
	def_bool $(shields_list_contains,ycgk_right)
```

## config/boards/shields/ycgk35/Kconfig.defconfig
```kconfig
# Copyright (c) 2020 The ZMK Contributors
# SPDX-License-Identifier: MIT

if SHIELD_YCGK35_LEFT

config ZMK_KEYBOARD_NAME
	default "ycgk35"

config ZMK_SPLIT_BLE_ROLE_CENTRAL
	default y

endif

if SHIELD_YCGK35_LEFT || SHIELD_YCGK35_RIGHT

config ZMK_SPLIT
	default y

endif
```

## config/boards/shields/ycgk35/Kconfig.shield
```kconfig
# Copyright (c) 2020 The ZMK Contributors
# SPDX-License-Identifier: MIT

config SHIELD_YCGK35_LEFT
	def_bool $(shields_list_contains,ycgk35_left)

config SHIELD_YCGK35_RIGHT
	def_bool $(shields_list_contains,ycgk35_right)
```
